## conf/layer.conf
```bitbake
# We have a conf and classes directory, append to BBPATH
BBPATH .= ":${LAYERDIR}"

BBFILES += "${LAYERDIR}/recipes*/*/*.bb ${LAYERDIR}/recipes*/*/*.bbappend ${LAYERDIR}/images/*.bb"

BBFILE_COLLECTIONS += "meta-flutter-plugins"
BBFILE_PATTERN_meta-flutter-plugins := "^${LAYERDIR}/"
BBFILE_PRIORITY_meta-flutter-plugins = "12"

LAYERSERIES_COMPAT_meta-flutter-plugins = "zeus dunfell honister hardknott gatesgarth"
```
